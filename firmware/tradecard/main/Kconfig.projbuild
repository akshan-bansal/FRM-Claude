## firmware/tradecard/main/Kconfig.projbuild
```kconfig
menu "TradeCard"

config TRADECARD_WIFI_SSID
    string "Wi-Fi SSID"
    default "your-ssid"

config TRADECARD_WIFI_PSK
    string "Wi-Fi password"
    default "your-password"

config TRADECARD_SHIM_URL
    string "Approval shim base URL"
    default "http://192.168.1.20:8787"
    help
        Base URL of the ApprovalRouter shim (scripts/approval_shim.py).
        Do not include a trailing slash.

config TRADECARD_SHIM_TOKEN
    string "Approval shim bearer token"
    default ""
    help
        The token the shim prints at startup ("auth required"). Sent as
        "Authorization: Bearer <token>" on every request. Leave empty only
        for a shim started with auth disabled on strict loopback. Stored in
        flash as plain text unless flash encryption is enabled.

config TRADECARD_CARD_ID
    string "Card ID"
    default "card-001"
    help
        Stable identifier this card presents to the shim. Persisted with
        the keypair; changing it forces a re-registration.

endmenu
```
